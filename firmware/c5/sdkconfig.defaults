## firmware/c5/sdkconfig.defaults
```kconfig
# 项目默认配置 —— 每次重新生成 sdkconfig 时自动生效
# 作用：防止 `idf.py set-target` / 换 IDE / 删 sdkconfig 之后 BLE 被悄悄关掉

# 蓝牙（BLE 测试服务要用）
CONFIG_BT_ENABLED=y
CONFIG_BT_NIMBLE_ENABLED=y
CONFIG_BT_NIMBLE_ROLE_PERIPHERAL=y
CONFIG_BT_NIMBLE_ROLE_CENTRAL=n
CONFIG_BT_NIMBLE_ROLE_BROADCASTER=y
CONFIG_BT_NIMBLE_ROLE_OBSERVER=n
CONFIG_BT_NIMBLE_MAX_CONNECTIONS=1
CONFIG_BT_NIMBLE_ATT_PREFERRED_MTU=256

# HTTP 服务器 WebSocket（页面姿态数据走 /ws）
CONFIG_HTTPD_WS_SUPPORT=y

# Flash：实测芯片 4 MB
CONFIG_ESPTOOLPY_FLASHSIZE_4MB=y

# 分区：单个大 app 分区（BLE + WiFi 一起编，1 MB 不够）
CONFIG_PARTITION_TABLE_SINGLE_APP_LARGE=y

# 日志：系统只留 WARN，自己的统计在运行时单独开到 INFO
CONFIG_LOG_DEFAULT_LEVEL_WARN=y
# CONFIG_LOG_MAXIMUM_EQUALS_DEFAULT is not set
CONFIG_LOG_MAXIMUM_LEVEL_INFO=y
CONFIG_BOOTLOADER_LOG_LEVEL_WARN=y
```
